

#include "ov7670.h"
#include "key.h"
#include "sccb.h"
#include "lcd.h"
#include "usart.h"

#ifdef OV7670_SW_V2
volatile u8 vsync_count	= 0;
#endif


volatile u8 capture_button_status = 1;
volatile u8 capture_status = 0;


#if 1
const  char ov7670_regs[][2]=
{
 	{0x3a, 0x04},
	{0x40, 0x10},  // 0XD0: RGB565 output 0X10: general 
	{0x12, 0x14},  //
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    {0x2d, 0x01},//0x82,//0xc0,//0xc2,	//night mode
};
#endif

#if 0
const  char ov7670_regs[CHANGE_REG_NUM][2]=
{	

	
	{0x3a, 0x04},
	{0x40, 0xd0},
	{0x12, 0x14},
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	{0x6e, 0x11},
//	{0x6f, 0x9f},//0x9e for advance AWB
	{0x6f, 0x9e},//0x9e for advance AWB
	{0x6a, 0x40},
	{0x01, 0x40},
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	{0x3b, 0x42},//0x82,//0xc0,//0xc2,	//night mode
};
#endif

#if 0
const unsigned char ov7670_regs[][2] = 
 {
 	{0x3a, 0x04},
	{0x40, 0xd0},

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	{0x3b, 0xc2}	   

 };

#endif


void CLK_init_ON(void)
{
    GPIO_InitTypeDef GPIO_InitStructure;
    // Clock output txz
    RCC_APB2PeriphClockCmd(RCC_APB2Periph_GPIOA, ENABLE);
    GPIO_InitStructure.GPIO_Pin = CAMERA_XCLK_PIN; 
    GPIO_InitStructure.GPIO_Speed = GPIO_Speed_50MHz; 
    GPIO_InitStructure.GPIO_Mode = GPIO_Mode_AF_PP ; 
    GPIO_Init(CAMERA_XCLK_PORT, &GPIO_InitStructure);
#ifdef STM32F10X_CL
    RCC_MCOConfig(RCC_MCO_HSI  );//hsi
#else
    RCC_MCOConfig(RCC_MCO_HSE  );//hsi
#endif


}
 
void CLK_init_OFF(void)
{

    GPIO_InitTypeDef GPIO_InitStructure;
    // Clock output txz
    RCC_APB2PeriphClockCmd(RCC_APB2Periph_GPIOA, ENABLE);
    GPIO_InitStructure.GPIO_Pin = CAMERA_XCLK_PIN; 
    GPIO_InitStructure.GPIO_Speed = GPIO_Speed_50MHz; 
    GPIO_InitStructure.GPIO_Mode = GPIO_Mode_Out_PP;
    GPIO_Init(CAMERA_XCLK_PORT, &GPIO_InitStructure);
    //RCC_MCOConfig(RCC_MCO_HSE  );//hsi

}

////////////////////////////
// Function: Write OV7670 register
// Returns: 1 - success 0 - failure
u8 wrOV7670Reg(u8 regID, u8 regDat)
{
	startSCCB();
	if(0==SCCBwriteByte(0x42))
	{
		stopSCCB();
		return(0);
	}
	DelaySCCB();
  	if(0==SCCBwriteByte(regID))
	{
		stopSCCB();
		return(0);
	}
	DelaySCCB();
  	if(0==SCCBwriteByte(regDat))
	{
		stopSCCB();
		return(0);
	}
  	stopSCCB();
	
  	return(1);
}

////////////////////////////
// Function: Read OV7670 register
// Returns: 1 - success 0 - failure
u8 rdOV7670Reg(u8 regID, u8 *regDat)
{
	// Set a write register address囹
	startSCCB();
	if(0==SCCBwriteByte(0x42))
	{
		stopSCCB();
		return(0);
	}
	DelaySCCB();
  	if(0==SCCBwriteByte(regID))
	{
		stopSCCB();
		return(0);
	}
	stopSCCB();
	
	DelaySCCB();
	
	// Set the register address is read
	startSCCB();
	if(0==SCCBwriteByte(0x43))
	{
		stopSCCB();
		return(0);
	}
	DelaySCCB();
  	*regDat=SCCBreadByte();
  	noAck();
  	stopSCCB();
  	return(1);
}


//(140,16,640,480) is good for VGA
//(272,16,320,240) is good for QVGA
/* config_OV7670_window */
void OV7670_config_window(u16 startx,u16 starty,u16 width, u16 height)
{
	u16 endx=(startx+width);
	u16 endy=(starty+height*2);// "v*2" must be
	u8 temp_reg1, temp_reg2;
	u8 state,temp;
	
	state = rdOV7670Reg(0x03, &temp_reg1 );
	temp_reg1 &= 0xC0;
	state = rdOV7670Reg(0x32, &temp_reg2 );
	temp_reg2 &= 0xC0;
	
	// Horizontal
	temp = temp_reg2|((endx&0x7)<<3)|(startx&0x7);
	state = wrOV7670Reg(0x32, temp );
	temp = (startx&0x7F8)>>3;
	state = wrOV7670Reg(0x17, temp );
	temp = (endx&0x7F8)>>3;
	state = wrOV7670Reg(0x18, temp );
	
	// Vertical
	temp = temp_reg1|((endy&0x7)<<3)|(starty&0x7);
	state = wrOV7670Reg(0x03, temp );
	temp = (starty&0x7F8)>>3;
	state = wrOV7670Reg(0x19, temp );
	temp = (endy&0x7F8)>>3;
	state = wrOV7670Reg(0x1A, temp );
	if(state==0){}
}

void my_delay_ms(u16 time)//delay some time
{
	u16 i;
	for(;time!=0;time--)
	{
		for(i=0;i<10000;i++);
	}
}

void camera_vsync_interrupt_event(void)
{		
	if( (!GPIO_ReadInputDataBit(KEY_USER_PORT, KEY1_USER_PIN )))
	{
		// 버튼 눌림
		capture_button_status = 0;
	}

	if( capture_button_status == 1 )
	{

		if(vsync_count < 2)
		{
			vsync_count++;
			//usart1_transmit_string_format("\r\nvsync_count++");
		}
		if(vsync_count==1)
		{
			FIFO_WRST_L();			// write pointer reset
			FIFO_CS_H();   		 	// turn off read buffer CS

#if 1
			LCD_WriteReg(0x0020,0);		// GRAM horizontal start position
			LCD_WriteReg(0x0021,319);     
			
			LCD_WriteReg(0x0050,0x00);		// horizontal direction GRAM start address
			LCD_WriteReg(0x0051,239);		// horizontal direction GRAM end address
			
			LCD_WriteReg(0x0052,0x00);		// vertical direction GRAM start address
			LCD_WriteReg(0x0053,319);		// vertical direction GRAM end address	

			// Display를 맨 마지막위치 에서부터 decrement 하면서 Display 하도록 한다.
			LCD_WriteReg(0x0003,0x1018); 		

			// GRAM prepare
			LCD_WR_REG(R34);	
#endif		


			FIFO_CS_L();    		// Enable read buffer
			FIFO_WRST_H();		// write pointer reset
			FIFO_WE_H(); 		 	// open the Write Enable

			//usart1_transmit_string_format("\r\nvsync_count=1");


		}
		else if(vsync_count==2)  
		{
			
			//usart1_transmit_string_format("\r\nvsync=2");	
			FIFO_WE_L();		 	// close the write enable ready to read data
			//FIFO_CS_H();   		// open reading
	

			//usart1_transmit_string_format("\r\nvsync=1");
		} 

	}
	else if( capture_button_status == 0 )
	{
		capture_status++;
		
          	if(capture_status>3)
			capture_status=3;
			
          	if(capture_status==1)
          	{
            	FIFO_WE_L();
            	FIFO_WRST_L();
				
            	//ov7670_set_cif();
				
           		FIFO_WRST_H();          

			//usart1_transmit_string_format("\r\nov7670_set_cif()");
          	}
          	else if(capture_status==2)
          	{
            	FIFO_WE_H();
			//usart1_transmit_string_format("\r\ncapture_status==2");
       
          	}
          	else if(capture_status==3)
          	{       
             	FIFO_WE_L();			
			//usart1_transmit_string_format("\r\ncapture_status==3 & vsync=1");
          	} 	
	}


}

#ifdef CAM_PCLK	
void camera_pclk_interrupt_event(void)
{
	if(my_x < 318)
	{

		if(flag1 == 0)
		{
			dat_cam = ((GPIOD->IDR&0xff)<<8);
			flag1 = 1;
		}
		else
		{
			LCD_DATAOUT(dat_cam | (GPIOD->IDR&0xff));
			LCD_WR=0; 
			LCD_WR=1; 
			flag1 = 0;

			my_x ++;
		} 
	}
}
#endif

#ifdef CAM_HREF
void camera_href_interrupt_event(void)
{	
	row++;
	
	// Set_Cs;
	LCD_SetCursor(row, 0);
	// wr_reg(0x20, row);
	// wr_reg(0x21, 0);	    
	// Clr_Cs;	  

	LCD_WR_REG(R34);
	// wr_cmd(0x22);

	LCD_RS = 1;			      	
	// Set_Rs;
	
	flag1 = 0;	    
	my_x = 0;
}
#endif

void init_camera_data_gpio(void)
{
	GPIO_InitTypeDef GPIO_InitStructure;
	EXTI_InitTypeDef EXTI_InitStructure;
	NVIC_InitTypeDef NVIC_InitStructure;

	// vsync interrupt
	register_camera_key_function(extiCameraVsyncServiceFunction, camera_vsync_interrupt_event);

#ifdef CAM_PCLK	
	register_camera_key_function(extiCameraPclkServiceFunction, camera_pclk_interrupt_event);
#endif
#ifdef CAM_HREF
	register_camera_key_function(extiCameraHrefServiceFunction, camera_href_interrupt_event);
#endif

#ifdef CAM_HREF
	// PC5(HREF) as interrupt pin
	GPIO_InitStructure.GPIO_Pin = CAMERA_HREF_PIN;
	GPIO_InitStructure.GPIO_Speed = GPIO_Speed_50MHz;
	GPIO_InitStructure.GPIO_Mode = GPIO_Mode_IPU;
	GPIO_Init(CAMERA_OV7670_PORT, &GPIO_InitStructure);


	GPIO_EXTILineConfig(GPIO_PortSourceGPIOC, GPIO_PinSource5);
	 // Configure EXTI Line5 to generate an interrupt on falling edge 
	EXTI_InitStructure.EXTI_Line = CAMERA_HREF_IRQ_EXTI_Line;
	EXTI_InitStructure.EXTI_Mode = EXTI_Mode_Interrupt;
	EXTI_InitStructure.EXTI_Trigger = EXTI_Trigger_Rising;
	EXTI_InitStructure.EXTI_LineCmd = ENABLE;
	EXTI_Init(&EXTI_InitStructure);	

#endif

#ifdef CAM_PCLK
	// PE9(PCLK) as an interrupt pin
	GPIO_InitStructure.GPIO_Pin = CAMERA_PCLK_PIN;
	GPIO_InitStructure.GPIO_Speed = GPIO_Speed_50MHz;
	GPIO_InitStructure.GPIO_Mode = GPIO_Mode_IPU;
	GPIO_Init(CAMERA_OV7670_PORT, &GPIO_InitStructure);	


	GPIO_EXTILineConfig(CAMERA_IRQ_PORT_SOURCE, CAMERA_PCLK_IRQ_PIN_SOURCE);  
	// Configure EXTI Line9 to generate an interrupt on falling edge
	EXTI_InitStructure.EXTI_Line = CAMERA_PCLK_IRQ_EXTI_Line;
	EXTI_InitStructure.EXTI_Mode = EXTI_Mode_Interrupt;
	EXTI_InitStructure.EXTI_Trigger = EXTI_Trigger_Rising;
	EXTI_InitStructure.EXTI_LineCmd = ENABLE;
	EXTI_Init(&EXTI_InitStructure);	

#endif	


	// FIFO 버퍼 Data 포트 초기화
	GPIO_InitStructure.GPIO_Pin = GPIO_Pin_0 | GPIO_Pin_1 | GPIO_Pin_2 |GPIO_Pin_3 | GPIO_Pin_4 | GPIO_Pin_5 | GPIO_Pin_6 |GPIO_Pin_7;								  
	GPIO_InitStructure.GPIO_Speed = GPIO_Speed_50MHz;
	GPIO_InitStructure.GPIO_Mode = GPIO_Mode_IN_FLOATING; // mp3 board --> GPIO_Mode_IPU;
	GPIO_Init(GPIOD, &GPIO_InitStructure);

	// PE6(VSYNC) as an interrupt pin
	GPIO_InitStructure.GPIO_Pin = CAMERA_VSYNC_PIN;
	GPIO_InitStructure.GPIO_Speed = GPIO_Speed_50MHz;
	GPIO_InitStructure.GPIO_Mode = GPIO_Mode_IN_FLOATING; // mp3 board --> GPIO_Mode_IPU;
	GPIO_Init(CAMERA_OV7670_PORT, &GPIO_InitStructure);

	GPIO_InitStructure.GPIO_Pin = FIFO_RD_PIN | FIFO_WRST_PIN | FIFO_RRST_PIN |FIFO_CS_PIN | FIFO_WE_PIN;
	GPIO_InitStructure.GPIO_Speed = GPIO_Speed_50MHz;
	GPIO_InitStructure.GPIO_Mode = GPIO_Mode_Out_PP;
	GPIO_Init(CAMERA_OV7670_PORT, &GPIO_InitStructure);	


	GPIO_EXTILineConfig(CAMERA_IRQ_PORT_SOURCE, CAMERA_VSYNC_IRQ_PIN_SOURCE);
	 // Configure EXTI Line6 to generate an interrupt on falling edge 
	EXTI_InitStructure.EXTI_Line = CAMERA_VSYNC_IRQ_EXTI_Line;
	EXTI_InitStructure.EXTI_Mode = EXTI_Mode_Interrupt;
	EXTI_InitStructure.EXTI_Trigger = EXTI_Trigger_Rising;
	EXTI_InitStructure.EXTI_LineCmd = ENABLE;
	EXTI_Init(&EXTI_InitStructure);

	// VSYNC line interrupt
	EXTI_GenerateSWInterrupt(CAMERA_VSYNC_IRQ_EXTI_Line);


	/* Configure the NVIC Preemption Priority Bits */  
	NVIC_PriorityGroupConfig(NVIC_PriorityGroup_0);  // mp3 board --> NVIC_PriorityGroup_0

	/* Enable the EXTI6 Interrupt on PE.6 */
	NVIC_InitStructure.NVIC_IRQChannel = CAMERA_VSYNC_IRQ_CHANNEL;
	NVIC_InitStructure.NVIC_IRQChannelPreemptionPriority = 1; // mp3 board --> 0;
	NVIC_InitStructure.NVIC_IRQChannelSubPriority = 2; // mp3 board --> 1;
	NVIC_InitStructure.NVIC_IRQChannelCmd = ENABLE;
	NVIC_Init(&NVIC_InitStructure);
	
	/* Enable the Key EXTI line Interrupt */
	NVIC_ClearPendingIRQ(CAMERA_VSYNC_IRQ_CHANNEL);	

#ifdef CAM_HREF
	/* Enable the EXTI5 Interrupt on PC.5 */
	NVIC_InitStructure.NVIC_IRQChannel = CAMERA_HREF_IRQ_CHANNEL;
	NVIC_InitStructure.NVIC_IRQChannelPreemptionPriority = 0;
	NVIC_InitStructure.NVIC_IRQChannelSubPriority = 1;
	NVIC_InitStructure.NVIC_IRQChannelCmd = ENABLE;
	NVIC_Init(&NVIC_InitStructure);

	/* Enable the Key EXTI line Interrupt */
	NVIC_ClearPendingIRQ(CAMERA_HREF_IRQ_CHANNEL);		
#endif
	

#ifdef CAM_PCLK
	/* Enable the EXTI9 Interrupt on PE.9 */
	NVIC_InitStructure.NVIC_IRQChannel = CAMERA_PCLK_IRQ_CHANNEL;
	NVIC_InitStructure.NVIC_IRQChannelPreemptionPriority = 0;
	NVIC_InitStructure.NVIC_IRQChannelSubPriority = 1;
	NVIC_InitStructure.NVIC_IRQChannelCmd = ENABLE;
	NVIC_Init(&NVIC_InitStructure);	
	
	/* Enable the Key EXTI line Interrupt */
	NVIC_ClearPendingIRQ(CAMERA_PCLK_IRQ_CHANNEL);			
#endif	

}

u8 ov7670_init(void)
{
	u8 temp;
	u8 i;
	    
	u8 ovidmsb=0;
	u8 ovidlsb=0;

	u8 rt=0;

	InitSCCB(); //io init..
	my_delay_ms(100);
	
	init_camera_data_gpio(); //io init..	
	my_delay_ms(100);

	CLK_init_ON();	
	my_delay_ms(100);

	temp=0x80;
	if(0==wrOV7670Reg(0x12, temp)) //Reset SCCB
	{
		usart1_transmit_string("Reset SCCB fail.\r\n");
	  	return 0;
	}
	my_delay_ms(100);

	rt = rdOV7670Reg(0x0a, &ovidmsb );
	if(ovidmsb !=0x76)
	{
		usart1_transmit_string("ov7670 0x76 fail.\r\n");
		return 0;
	}

	rdOV7670Reg(0x0b, &ovidlsb );
	if(ovidlsb !=0x73)
	{
		usart1_transmit_string("ov7670 0x0b fail.\r\n");	
		return 0;
	}	

	for(i=0;i<sizeof(ov7670_regs)/sizeof(ov7670_regs[0])/2;i++)
	{
		if( 0==wrOV7670Reg(ov7670_regs[i][0],ov7670_regs[i][1]))
		{
			usart1_transmit_string("ov7670 reg write fail.\r\n");
			return 0;
		}
	}

	// OV7670_config_window(140,16,640,480);//(140,16,640,480) is good for VGA
	// OV7670_config_window(272,16,320,240);// set 240*320

	my_delay_ms(200);	

	return 0x01; //ok
} 

void ov7670_set_qvga(void)   
{   
    while(1!= wrOV7670Reg(0x12, 0x14));
//  wrOV7670Reg(0x40, 0xd0);     
    wrOV7670Reg(0x17, 0x16);   
    wrOV7670Reg(0x18, 0x04);   
    wrOV7670Reg(0x19, 0x02);   
    wrOV7670Reg(0x1A, 0x7B); 
    wrOV7670Reg(0x32, 0x40);
     
    wrOV7670Reg(0x03, 0x0a); 
//  wrOV7670Reg(0x3E, 0x1A); 
   
    wrOV7670Reg(0x70, 0x3A); 
    wrOV7670Reg(0x71, 0x35);  
    wrOV7670Reg(0x72, 0x11);   
    wrOV7670Reg(0x73, 0xF9); 
    wrOV7670Reg(0xA2, 0x02);    
}
void ov7670_set_cif(void)   
{   
  // unsigned char regval;  
   
    while(1!= wrOV7670Reg(0x12, 0x24));   
   // wrOV7670Reg(0x40, 0xC0);   
    wrOV7670Reg(0x17, 0x15);   
    wrOV7670Reg(0x18, 0x0B);   
    wrOV7670Reg(0x19, 0x03);   
    wrOV7670Reg(0x1A, 0x7b);
    
    wrOV7670Reg(0x03, 0x0a); 
    wrOV7670Reg(0x32, 0xb6);
    
    //wrOV7670Reg(0x0C, 0x08); 

    wrOV7670Reg(0x70, 0x3A); 
    wrOV7670Reg(0x71, 0x35);  
    wrOV7670Reg(0x72, 0x11);   
    wrOV7670Reg(0x73, 0xF2); 
    wrOV7670Reg(0xA2, 0x02);        
}



